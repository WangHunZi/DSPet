## main/Kconfig.projbuild
```kconfig
menu "DSPet display"
    config DSPET_LCD_SPI_MHZ
        int "LCD SPI clock (MHz)"
        range 1 40
        default 40
    config DSPET_LCD_SPI_MODE
        int "LCD SPI mode (0 or 3)"
        range 0 3
        default 0
        help
            Use mode 0 normally; mode 3 is available for panel diagnosis.
    config DSPET_LCD_Y_GAP
        int "LCD RAM Y offset"
        range 0 80
        default 0
    config DSPET_LCD_INVERT
        bool "Enable panel inversion"
        default y
    config DSPET_LCD_BGR
        bool "Swap red and blue"
        default n
    config DSPET_LCD_COLOR_TEST
        bool "Show RGB/white/black test before character playback"
        default n
endmenu

menu "DSPet audio"
    config DSPET_AEC
        bool "Enable the ESP-SR acoustic echo cancellation service"
        depends on IDF_TARGET_ESP32S3
        default n
        help
            Enable PSRAM before building this service. Use octal mode on
            XIAO ESP32S3 Plus.

    config DSPET_AUDIO_CHECK
        bool "Run the offline I2S hardware check at boot"
        default y

    config DSPET_PLAYBACK_DEMO
        bool "Use BOOT to play or stop a local speech demo"
        default n
        help
            Generate .cache/playback-demo.pcm with tools/make_playback_demo.sh.
            When enabled, BOOT toggles demo playback instead of switching animations.
    config DSPET_AUDIO_DUPLEX_PROBE
        bool "Measure microphone and playback DMA timing in the speech demo"
        depends on DSPET_PLAYBACK_DEMO
        default n
        help
            Enable simultaneous I2S capture and report block statistics.
            Microphone and reference samples stay inside the device.

    config DSPET_DUPLEX_AUTO_TEST
        bool "Automatically exercise playback, cancellation and normal completion once"
        depends on DSPET_AUDIO_DUPLEX_PROBE
        default n
        help
            Run the speech demo sequence once after boot. A BOOT press
            cancels the automatic sequence and toggles playback manually.

    config DSPET_LOCAL_VOICE
        bool "Enable offline voice sessions and the Ni Hao Xiao Zhi wake word"
        depends on DSPET_AEC && !DSPET_AUDIO_CHECK && !DSPET_PLAYBACK_DEMO
        default n
        help
            Select wn9_nihaoxiaozhi_tts in ESP Speech Recognition and
            flash the whole project, including the model partition.
endmenu

menu "DSPet playback"
    config DSPET_AUTO_PLAY
        bool "Automatically play the next action when a clip finishes"
        default y
endmenu

menu "DSPet serial shell"
    config DSPET_SERIAL_SHELL
        bool "Enable the DSPet USB Serial/JTAG shell"
        depends on ESP_CONSOLE_USB_SERIAL_JTAG
        default y

    config DSPET_CONSOLE_TESTS
        bool "Enable on-demand serial audio tests"
        depends on DSPET_SERIAL_SHELL && !DSPET_PLAYBACK_DEMO
        default n
        help
            Use the shared audio device for one serial test at a time.
            Requires the local speech fixture and PSRAM for audio tests.

    config DSPET_DIRECT_TEST
        bool "Enable serial Wi-Fi and direct DeepSeek diagnostics"
        default n
        help
            Requires console tests and PSRAM. Enable on-demand station scanning,
            HTTPS chat and TTS playback with one-shot credentials held in RAM.
    config DSPET_PROVISIONING
        bool "Enable phone provisioning and saved direct voice startup"
        depends on DSPET_DIRECT_TEST && DSPET_LOCAL_VOICE
        default n
        help
            Show a temporary WPA2 SoftAP QR code until Wi-Fi and DeepSeek
            credentials are provisioned. Hold BOOT for five seconds and
            release to erase the DSPet setup record and reboot.
endmenu
```

## sdkconfig.defaults
```kconfig
CONFIG_IDF_TARGET="esp32s3"
CONFIG_ESPTOOLPY_FLASHSIZE_16MB=y
CONFIG_ESPTOOLPY_FLASHMODE_DIO=y
CONFIG_ESPTOOLPY_FLASHFREQ_40M=y
CONFIG_ESP_CONSOLE_USB_SERIAL_JTAG=y
CONFIG_FREERTOS_HZ=1000
CONFIG_PARTITION_TABLE_CUSTOM=y
CONFIG_PARTITION_TABLE_CUSTOM_FILENAME="partitions.csv"
CONFIG_DSPET_LCD_SPI_MHZ=40
CONFIG_ESP_DEFAULT_CPU_FREQ_MHZ_240=y
```
